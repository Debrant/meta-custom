## conf/layer.conf
```bitbake
# We have a conf and classes directory, add to BBPATH
BBPATH .= ":${LAYERDIR}"

# We have a packages directory, add to BBFILES
BBFILES += "${LAYERDIR}/recipes-*/*/*.bb \
            ${LAYERDIR}/recipes-*/*/*.bbappend"

BBFILE_COLLECTIONS += "tiger6"
BBFILE_PATTERN_tiger6 := "^${LAYERDIR}/"
BBFILE_PRIORITY_tiger6 = "6"

LAYERDEPENDS_tiger6 = "digi-arm digi-dey"
```

## conf/machine/custom.conf
```bitbake
#@TYPE: Machine
#@NAME: Custom platform
#@DESCRIPTION: Machine configuration for custom platform.

# Contains the ConnectCore 6 module.
include conf/machine/include/ccimx6.inc

# U-Boot configurations
# Last one is the default (the one the symlinks point at)
UBOOT_CONFIG ??= "custom"
UBOOT_CONFIG[custom] = "custom_defconfig"

KERNEL_DEVICETREE ?= " \
    imx6q-custom.dtb \
    imx6q-custom-w.dtb \
    imx6q-custom-wb.dtb \
"

SERIAL_CONSOLES ?= "115200;ttymxc3"

# Bluetooth tty
BT_TTY ?= "ttymxc1"

# U-Boot script to be copied to the boot image
BOOT_SCRIPTS = "boot.scr:boot.scr"

# Flash image types
IMAGE_FSTYPES ?= "boot.vfat ext4 sdcard tar.bz2 recovery.vfat"
```

## conf/machine/tiger6.conf
```bitbake
#@TYPE: Machine
#@NAME: Tiger6 platform
#@DESCRIPTION: Machine configuration for Tiger6 platform.

# Include the machine configuration for Digi's ConnectCore 6UL.
include conf/machine/include/ccimx6ul.inc

# U-Boot configurations
# Last one is the default (the one the symlinks point at)
UBOOT_CONFIG ??= "tiger6"
UBOOT_CONFIG[custom] = "tiger6_defconfig"

KERNEL_DEVICETREE ?= " \
    imx6ul-t6.dtb \
"

SERIAL_CONSOLES ?= "115200;ttymxc4"

# Bluetooth tty

# U-Boot script to be copied to the boot image
BOOT_SCRIPTS = "boot.scr:boot.scr"

# Flash image types
IMAGE_FSTYPES ?= "tar.bz2 ubifs boot.ubifs recovery.ubifs"
```
